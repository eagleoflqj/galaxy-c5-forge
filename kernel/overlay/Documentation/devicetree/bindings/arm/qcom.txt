## kernel/overlay/drivers/irqchip/qcom/Kconfig
```kconfig
config QTI_PDC
        bool "QTI PDC"
        depends on ARCH_QCOM
	select IRQ_DOMAIN
	select IRQ_DOMAIN_HIERARCHY
        help
          QTI Power Domain Controller driver to manage and configure wakeup
          IRQs

config QTI_PDC_SDM845
        bool "QTI PDC SDM845"
        select QTI_PDC
        default y if ARCH_SDM845
        help
          QTI Power Domain Controller for SDM845

config QTI_PDC_SDM670
        bool "QTI PDC SDM670"
        select QTI_PDC
        default y if ARCH_SDM670
        help
          QTI Power Domain Controller for SDM670

config QTI_PDC_SDXPOORWILLS
        bool "QTI PDC SDxPOORWILLS"
        select QTI_PDC
        default y if ARCH_SDXPOORWILLS
        help
          QTI Power Domain Controller for SDxPoorwills

config QTI_MPM
	bool "QTI MPM"
	depends on ARCH_QCOM
	select IRQ_DOMAIN
	select IRQ_DOMAIN_HIERARCHY
	help
	  QTI MSM Power Manager driver to manage and configure wakeup
	  IRQs.

config QTI_MPM_C5LTE
	bool "C5 MPM mapping and conservative XO experiment"
	depends on QTI_MPM && ARCH_MSM8952 && (COMPILE_TEST || C5_RECOVERY_ONLY) && HAVE_CLK
	help
	  Select only the measured c5lte wake maps, not neighboring SoC maps.
	  Include C5-only IRQ tracking and a conservative XO clock vote. Device
	  tree, RPM transport, timer semantics and hardware wake validation remain
	  mandatory before acceptance. C5_RECOVERY_ONLY permits a separately
	  authorized diagnostic recovery experiment without COMPILE_TEST.
```

## kernel/overlay/drivers/muic/universal/Kconfig
```kconfig
#
# MUIC devices
#

comment "MUIC configs"

config MUIC_UNIVERSAL
  bool "UNIVERSAL MUIC"
	depends on USE_MUIC
	default n
	help
	  If you say yes here you will get support for various MUIC chips.

config MUIC_UNIVERSAL_SM5703
  bool "SM5703 MUIC"
	depends on USE_MUIC
	default n
	help
	  If you say yes here you will get support for the SM5703 MUIC chip.

config MUIC_UNIVERSAL_SM5705
	bool "SM5705 MUIC"
	depends on USE_MUIC
	default n
	help
	  If you say yes here you will get support for the SM5705 MUIC chip.

config MUIC_UNIVERSAL_SM5705_AFC
	bool "SM5705 MUIC AFC"
	depends on USE_MUIC
	default n
	help
	  If you say yes here you will get support for the SM5705 MUIC
	  AFC feature.

config MUIC_UNIVERSAL_SM5504
  bool "SM5504 MUIC"
	depends on USE_MUIC
	default n
	help
	  If you say yes here you will get support for the SM5504 MUIC chip.

config MUIC_PINCTRL
  bool "MUIC PINCTRL"
	depends on USE_MUIC
	default n
	help
	  If you say yes here you will get support for the Pinctrl in MUIC driver.

config MUIC_SUPPORT_RUSTPROOF
	bool "MUIC Disable UART"
	depends on !SEC_FACTORY
	default n
	help
	 This option will disable the UART to prevent the rusting of the
	 IF Connector in the case of Kmini Devices.

config SM5705_SUPPORT_LANHUB
	bool "LANHUB Support for SM5705 MUIC"
	depends on MUIC_UNIVERSAL_SM5705
	default n
	help
	 This option will provide USB LANHUB support to SM5705 MUIC based
	 devices.

config MUIC_SUPPORT_GAMEPAD
	bool "GAMEPAD Support for MUIC"
	depends on MUIC_UNIVERSAL
	default n
	help
	 This option will provide GAMEPAD support to MUIC based
	 devices.


config C5_MUIC_RESUME_IRQ_RECHECK
	bool "C5 SM5705 pending MUIC IRQ check after resume"
	depends on ARCH_MSM8952 && PM && GPIOLIB
	depends on MUIC_UNIVERSAL && MUIC_UNIVERSAL_SM5705
	depends on MUIC_UNIVERSAL_SM5705_AFC
	default n
	help
	  On the C5 board, a falling-edge SM5705 interrupt may remain low
	  across suspend. Re-enabling TLMM can clear the pending edge.
	  After re-enabling the IRQ, sample the existing input once and
	  run the existing serialized handler once if it is low. Expose
	  read-only per-device resume counters, without polling, changing
	  GPIO direction, IRQ type or other boards' interrupt handling.


config C5_LEGACY_UART3_NOTIFY
	bool "C5 legacy MUIC UART jig notification"
	depends on C5_RECOVERY_ONLY && ARCH_MSM8952 && ARM64 && OF
	depends on !CPU_BIG_ENDIAN && !MODULES
	depends on MUIC_UNIVERSAL && MUIC_UNIVERSAL_SM5705
	depends on MUIC_NOTIFIER && SWITCH
	default n
	select UART3
	help
	  Restore the legacy uart3 switch notification for UART-OFF jig
	  attach/detach. This is a software notification, not a UART driver
	  or a request to change the MUIC routing, clocks or registers.

config UART3
	bool
```

## kernel/overlay/drivers/sensors/Kconfig
```kconfig
config SENSORS_SSC
	bool "Enable Sensors Driver Support for SSC"
	help
	  Add support for sensors SSC driver.
	  This driver is used for exercising sensors use case,
	  time syncing with ADSP clock.

config SENSORS_CORE
    bool "C5 Samsung sensor class"
    depends on C5_RECOVERY_ONLY && INPUT
    default n

config SENSORS_BHI
    bool "C5 Bosch BHA250 sensor hub"
    depends on C5_RECOVERY_ONLY && I2C && INPUT && SENSORS_CORE && IIO && IIO_BUFFER && IIO_KFIFO_BUF
    default n

config SENSORS_TMD3700
    bool "C5 original TMD3700 light and proximity"
    depends on C5_RECOVERY_ONLY && I2C && INPUT && SENSORS_CORE && OF && GPIOLIB
    default n

config SENSORS_TMD3700_RESET_DEFENCE_CODE
    bool "Original TMD3700 sensor-hub reset callbacks"
    depends on SENSORS_TMD3700
    default n

config SENSORS_YAS539
    bool "C5 original Yamaha YAS539 magnetic sensor"
    depends on C5_RECOVERY_ONLY && I2C && INPUT && SENSORS_CORE && OF
    default n

config SENSORS_YAS_RESET_DEFENCE_CODE
    bool "Original YAS539 sensor-hub reset callbacks"
    depends on SENSORS_YAS539
    default n

config C5_SSC_TIMER_COMPAT
	bool "C5 legacy SSC physical slow-timer interface"
	depends on ARM64 && QTI_MPM_C5LTE && !SENSORS_SSC
	default n
	help
	  Provide the legacy /dev/sensors slow-timer ioctl for the fixed C5
	  profile using the already registered physical counter frame and
	  cached native read permission. This does not load SSC firmware,
	  register SLPI controls or change the native timer implementation.
```

## kernel/overlay/drivers/soc/samsung/Kconfig
```kconfig
#
# SAMSUNG SoC drivers
#
menuconfig SOC_SAMSUNG
	bool "Samsung SoC driver support" if COMPILE_TEST

if SOC_SAMSUNG

config C5_CHARGING_MODE
	bool
	depends on ARCH_MSM8952
	help
	  Preserve the original C5 androidboot.mode charging identity. This
	  shared provider is not a battery, charger or charger-UI implementation.

config EXYNOS_PMU
	bool "Exynos PMU controller driver" if COMPILE_TEST
	depends on (ARM && ARCH_EXYNOS) || ((ARM || ARM64) && COMPILE_TEST)

config EXYNOS_PM_DOMAINS
	bool "Exynos PM domains" if COMPILE_TEST
	depends on PM_GENERIC_DOMAINS || COMPILE_TEST

endif
```

## kernel/overlay/drivers/soundwire/Kconfig
```kconfig
config C5_SOUNDWIRE_CORE
	bool "C5 isolated legacy SoundWire bus core"
	depends on ARM64 && OF && C5_RECOVERY_ONLY && !MODULES
	depends on !SOUNDWIRE && !SOUNDWIRE_WCD_CTRL
	default n
	help
	  Restore the old SoundWire bus/root and callable core API on the fixed
	  C5 source profile. This does not select a controller, codec, regmap,
	  device-tree node or hardware operation. Legacy global SOUNDWIRE and
	  SOUNDWIRE_WCD_CTRL must stay off to ensure one provider. No defaults
	  or current profile are changed by this opt-in source candidate.
```

## kernel/overlay/techpack/Kconfig
```kconfig
menu "Tech packages"

config C5_AUDIO
	bool "C5 MSM8952/RT5659 native audio"
	depends on ARCH_MSM8952 && SND_SOC && I2C && MSM_SMD
	select SLIMBUS
	help
	  Build the C5 board/codec driver and native APR/QDSP6 transport.
	  This is independent of newer-SoC audio auto-configuration files.

config TECHPACK_AUDIO_DISABLE
	bool "Disable compilation for audio module"
	default n
	help
	  Say Y here to disable compilation for audio module.
	  Sometimes useful for reducing kernel binary size.

source "techpack/camera-legacy/Kconfig"
source "techpack/camera-legacy-m/Kconfig"
source "techpack/xiaomi-msm8937/Kconfig"
source "techpack/xiaomi-sdm439/Kconfig"

endmenu

config C5_CAMERA
	bool "Samsung C5 legacy camera compatibility"
	depends on MSMB_CAMERA && !MSMB_CAMERA_ENABLE
	select VIDEOBUF2_CORE

config MSM_FRONT_EEPROM
	bool
	default y if C5_CAMERA

config C5_VIDC
	bool "Samsung C5 frozen codec compatibility"
	depends on VIDEO_V4L2 && !MSM_VIDC_V4L2 && !MSM_VIDC_3X_V4L2 && ARM64_DMA_USE_IOMMU && IOMMU_API && ION
	select VIDEOBUF2_CORE

source "techpack/c5-peripherals/Kconfig"
```

## kernel/overlay/techpack/c5-peripherals/Kconfig
```kconfig
config C5_HALL
    bool "Samsung C5 legacy Hall lid switch"
    depends on INPUT && GPIOLIB && OF

config ANDROID_TIMED_OUTPUT
    bool "Legacy Android timed output interface"

config C5_DC_VIBRATOR
    bool "Samsung C5 regulator DC vibrator"
    depends on OF && REGULATOR && PM
    select ANDROID_TIMED_OUTPUT

config LEDS_SM5705_RGB
    bool "C5 SM5705 notification RGB LED"
    depends on MFD_SM5705 && LEDS_CLASS

config SEC_THERMISTOR
    bool "C5 calibrated AP thermistor"
    depends on HWMON && SENSORS_QPNP_ADC_VOLTAGE
```
