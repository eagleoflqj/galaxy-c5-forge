## kernel/overlay/Documentation/devicetree/bindings/arm/qcom.txt
```
QCOM device tree bindings
-------------------------

Some qcom based bootloaders identify the dtb blob based on a set of
device properties like SoC and platform and revisions of those components.
To support this scheme, we encode this information into the board compatible
string.

Each board must specify a top-level board compatible string with the following
format:

	compatible = "qcom,<SoC>[-<soc_version>][-<foundry_id>]-<board>[/<subtype>][-<board_version>]"

The 'SoC' and 'board' elements are required. All other elements are optional.

The 'SoC' element must be one of the following strings:

	apq8016
	apq8074
	apq8084
	apq8096
	msm8916
	msm8974
	msm8996

The 'board' element must be one of the following strings:

	cdp
	liquid
	dragonboard
	mtp
	sbc

The 'soc_version' and 'board_version' elements take the form of v<Major>.<Minor>
where the minor number may be omitted when it's zero, i.e.  v1.0 is the same
as v1. If all versions of the 'board_version' elements match, then a
wildcard '*' should be used, e.g. 'v*'.

The 'foundry_id' and 'subtype' elements are one or more digits from 0 to 9.

Examples:

	"qcom,msm8916-v1-cdp-pm8916-v2.1"

A CDP board with an msm8916 SoC, version 1 paired with a pm8916 PMIC of version
2.1.

	"qcom,apq8074-v2.0-2-dragonboard/1-v0.1"

A dragonboard board v0.1 of subtype 1 with an apq8074 SoC version 2, made in
foundry 2.

Samsung C5 platform namespace compatibility
------------------------------------------

The C5 Android userspace expects the root SoC platform device named soc.0,
including its bootdevice link and existing sysfs permission paths. Native
address-derived names of child devices are unchanged.

Optional property on the root child /soc:

- samsung,c5lte-legacy-soc-name: empty boolean selecting the C5 legacy name.
  This is valid only for an unnamed platform device on the root's direct
  /soc child, named soc, compatible with simple-bus, without a reg property.
  Other nodes, nonempty values and already named devices retain the native
  naming algorithm. It does not restore the old global naming counter or
  rename other Qualcomm boards or untranslated child devices.

  When the caller supplies neither an explicit parent nor a bus_id override,
  the selected root device retains a NULL parent, matching the C5 legacy
  /devices/soc.0 hierarchy instead of the native /devices/platform/soc.0.
  Explicit caller parents and names, malformed selections and other nodes
  retain native parent assignment. Address-derived children retain the
  actual caller parent. This does not establish real sysfs or uevent paths.

The reviewed C5 board description must select this explicitly. Naming is
not storage probing, mount, firmware, or boot acceptance.
```

## kernel/overlay/Documentation/devicetree/bindings/interrupt-controller/qcom,c5lte-mpm-xo.txt
```
C5-only conservative MPM XO policy (host integration experiment)

This policy node is separate from the early MPM interrupt controllers because
of_irq_init marks IRQCHIP_DECLARE nodes OF_POPULATED before platform population.
Do not clear that flag or instantiate a second IRQ controller.

Required properties:
- compatible: "qcom,mpm-c5lte-xo"
- qcom,mpm-gic-domain: phandle of the "qcom,mpm-gic-c5lte", "qcom,mpm-gic" controller
- qcom,mpm-gpio-domain: phandle of the "qcom,mpm-gpio-c5lte", "qcom,mpm-gpio" controller
- clocks: phandle/specifier for the board's XO low-power clock voter
- clock-names: "xo"

Both early domains must be successfully initialized. The GIC parent must be
the measured GICv2 linear domain; GPIO IRQs are bounded by the measured C5
134-pin controller. No LPI or neighboring-board mapping is accepted.
The GPIO MPM node must set interrupt-parent to the C5 GIC MPM node, enforcing
successful GIC/MPM MMIO initialization before GPIO-domain publication.

Unlisted enabled OR wake-enabled IRQs retain XO and prohibit RPM deep sleep.
Mapped and measured bypass IRQs do not require this XO vote. This conservative
union intentionally sacrifices some suspend depth rather than switching
bitmaps using unvalidated PM transition ordering. It is not a hardware wake
acceptance result and must not be represented as legacy power-policy parity.

No clock provider/specifier is invented here. Reconcile the measured C5 clock
binding with the 4.9 provider before adding a board node. Missing/deferred
clocks, invalid domain references and failed votes leave deep sleep closed.
```

## kernel/overlay/arch/arm64/configs/c5lte_4_9_component_defconfig
```kconfig
# Compile-only API/binding feasibility experiment. NOT a bootable c5lte config.
CONFIG_COMPILE_TEST=y
CONFIG_LOCALVERSION="-c5lte-component-lab"
CONFIG_ARCH_QCOM=y
CONFIG_ARCH_MSM8952=y
CONFIG_SMP=y
CONFIG_NR_CPUS=8
CONFIG_NO_HZ_IDLE=y
CONFIG_DEBUG_FS=y
CONFIG_COMPAT=y
CONFIG_GPIOLIB=y
CONFIG_PINCTRL_MSM_TLMM=y
CONFIG_ARM_SMMU=y
CONFIG_QCOM_SCM=y
CONFIG_BLK_DEV_INITRD=y
CONFIG_DEVTMPFS=y
CONFIG_TMPFS=y
CONFIG_AIO=y
CONFIG_ADVISE_SYSCALLS=y
CONFIG_FHANDLE=y
CONFIG_EVENTFD=y
CONFIG_SIGNALFD=y
CONFIG_TIMERFD=y
CONFIG_EPOLL=y
CONFIG_NET=y
CONFIG_UNIX=y
CONFIG_INET=y
CONFIG_TTY=y
CONFIG_SOUND=y
CONFIG_SND=y
CONFIG_SND_SOC=y
CONFIG_USB=y
CONFIG_USB_GADGET=y
CONFIG_USB_CI13XXX_MSM=y
CONFIG_USB_CONFIGFS=y
CONFIG_USB_CONFIGFS_F_FS=y
CONFIG_USB_CONFIGFS_F_MTP=y
CONFIG_STAGING=y
CONFIG_ANDROID=y
CONFIG_ANDROID_BINDER_IPC=y
CONFIG_ANDROID_BINDER_DEVICES="binder,hwbinder,vndbinder"
CONFIG_ASHMEM=y
CONFIG_SECURITY=y
CONFIG_SECURITY_NETWORK=y
CONFIG_AUDIT=y
CONFIG_SECURITY_SELINUX=y
CONFIG_DEFAULT_SECURITY_SELINUX=y
CONFIG_SECCOMP=y
CONFIG_SECCOMP_FILTER=y
```

## kernel/overlay/arch/arm64/configs/c5lte_recovery_defconfig
```kconfig
CONFIG_LOCALVERSION="-c5lte-board-candidate"
# CONFIG_LOCALVERSION_AUTO is not set
CONFIG_AUDIT=y
CONFIG_NO_HZ_IDLE=y
CONFIG_SCHED_WALT=y
CONFIG_CGROUPS=y
CONFIG_CGROUP_CPUACCT=y
CONFIG_CPUSETS=y
CONFIG_BLK_DEV_INITRD=y
CONFIG_ARCH_QCOM=y
CONFIG_ARCH_MSM8952=y
CONFIG_NR_CPUS=8
CONFIG_CMA=y
CONFIG_SECCOMP=y
CONFIG_COMPAT=y
CONFIG_CPU_IDLE=y
CONFIG_CPU_FREQ=y
CONFIG_CPU_FREQ_DEFAULT_GOV_INTERACTIVE=y
CONFIG_CPU_FREQ_GOV_INTERACTIVE=y
CONFIG_CPU_FREQ_MSM=y
CONFIG_NET=y
CONFIG_UNIX=y
CONFIG_INET=y
CONFIG_DEVTMPFS=y
CONFIG_DMA_CMA=y
CONFIG_MD=y
CONFIG_BLK_DEV_DM=y
CONFIG_DM_CRYPT=y
CONFIG_DM_REQ_CRYPT=y
CONFIG_INPUT_EVDEV=y
CONFIG_KEYBOARD_GPIO=y
CONFIG_INPUT_TOUCHSCREEN=y
CONFIG_TOUCHSCREEN_ZT7538=y
CONFIG_SECURE_TOUCH=y
CONFIG_INPUT_MISC=y
CONFIG_INPUT_QPNP_POWER_ON=y
CONFIG_MSM_SMD_PKT=y
CONFIG_I2C_MSM_V2=y
CONFIG_I2C_GPIO=y
CONFIG_SPMI=y
CONFIG_MFD_SPMI_PMIC=y
CONFIG_GPIOLIB=y
CONFIG_GPIO_QPNP_PIN=y
CONFIG_POWER_RESET_QCOM=y
CONFIG_BATTERY_SAMSUNG=y
CONFIG_BATTERY_SWELLING=y
CONFIG_BATTERY_AGE_FORECAST=y
CONFIG_MULTI_CHARGING=y
CONFIG_STEP_CHARGING=y
CONFIG_FUELGAUGE_SM5705=y
CONFIG_PREVENT_SOC_JUMP=y
CONFIG_CHARGER_SM5705=y
CONFIG_CHARGER_DA9155=y
CONFIG_AFC_CHARGER_MODE=y
CONFIG_SAMSUNG_LPM_MODE=y
CONFIG_CHANGE_VBUS_VOLTAGE=y
CONFIG_SEC_MPP_SHARE=y
CONFIG_SEC_MPP_SHARE_LOW_TEMP_WA=y
CONFIG_SAMSUNG_JACK=y
CONFIG_VBUS_NOTIFIER=y
CONFIG_USE_MUIC=y
CONFIG_MUIC_UNIVERSAL=y
CONFIG_MUIC_UNIVERSAL_SM5705=y
CONFIG_MUIC_UNIVERSAL_SM5705_AFC=y
CONFIG_MUIC_PINCTRL=y
CONFIG_MUIC_SUPPORT_RUSTPROOF=y
CONFIG_MUIC_SUPPORT_GAMEPAD=y
CONFIG_THERMAL_TSENS8974=y
CONFIG_THERMAL_MONITOR=y
CONFIG_REGULATOR_SM5705=y
CONFIG_THERMAL=y
CONFIG_THERMAL_QPNP=y
CONFIG_THERMAL_QPNP_ADC_TM=y
CONFIG_SENSORS_QPNP_ADC_VOLTAGE=y
CONFIG_REGULATOR=y
CONFIG_REGULATOR_FIXED_VOLTAGE=y
CONFIG_REGULATOR_CPR=y
CONFIG_REGULATOR_MEM_ACC=y
CONFIG_REGULATOR_QPNP_LABIBB=y
CONFIG_REGULATOR_QPNP=y
CONFIG_REGULATOR_RPM_SMD=y
CONFIG_REGULATOR_SPM=y
CONFIG_QCOM_KGSL=y
CONFIG_FB=y
CONFIG_FB_MSM=y
CONFIG_FB_MSM_MDSS_SAMSUNG=y
CONFIG_FB_MSM_MDSS=y
CONFIG_SOUND=y
CONFIG_SND=y
CONFIG_SND_SOC=y
CONFIG_USB=y
CONFIG_USB_GADGET=y
CONFIG_USB_GADGET_VBUS_DRAW=500
CONFIG_USB_CI13XXX_MSM=y
CONFIG_USB_CONFIGFS=y
CONFIG_USB_CONFIGFS_F_FS=y
CONFIG_USB_CONFIGFS_F_MTP=y
CONFIG_USB_CONFIGFS_UEVENT=y
CONFIG_MMC=y
CONFIG_MMC_CLKGATE=y
CONFIG_MMC_BLOCK_MINORS=32
CONFIG_MMC_SDHCI=y
CONFIG_MMC_SDHCI_PLTFM=y
CONFIG_MMC_SDHCI_MSM=y
CONFIG_MMC_SDHCI_MSM_ICE=y
CONFIG_NEW_LEDS=y
CONFIG_LEDS_CLASS=y
CONFIG_LEDS_TRIGGERS=y
CONFIG_RTC_CLASS=y
CONFIG_RTC_DRV_QPNP=y
CONFIG_DMADEVICES=y
CONFIG_QCOM_SPS_DMA=y
CONFIG_STAGING=y
CONFIG_ASHMEM=y
CONFIG_ION=y
CONFIG_ION_MSM=y
CONFIG_SPS=y
CONFIG_SPS_SUPPORT_NDP_BAM=y
CONFIG_QPNP_REVID=y
CONFIG_USB_BAM=y
CONFIG_REMOTE_SPINLOCK_MSM=y
CONFIG_MAILBOX=y
CONFIG_ARM_SMMU=y
CONFIG_MSM_SPM=y
CONFIG_QCOM_SCM=y
CONFIG_QCOM_WATCHDOG_V2=y
CONFIG_MSM_RPM_SMD=y
CONFIG_QCOM_BUS_SCALING=y
CONFIG_QCOM_SECURE_BUFFER=y
CONFIG_MSM_SMEM=y
CONFIG_MSM_SMD=y
CONFIG_MSM_TZ_SMMU=y
CONFIG_MSM_SMP2P=y
CONFIG_MSM_SUBSYSTEM_RESTART=y
CONFIG_MSM_PIL=y
CONFIG_MSM_PIL_SSR_GENERIC=y
CONFIG_MSM_PIL_MSS_QDSP6V5=y
CONFIG_MSM_PM=y
CONFIG_QTI_MPM=y
CONFIG_QTI_MPM_C5LTE=y
CONFIG_PINCTRL_MSM_TLMM=y
CONFIG_GENERIC_PHY=y
CONFIG_ANDROID=y
CONFIG_ANDROID_BINDER_IPC=y
CONFIG_EXT4_FS=y
CONFIG_EXT4_FS_SECURITY=y
CONFIG_F2FS_FS=y
CONFIG_F2FS_FS_SECURITY=y
CONFIG_VFAT_FS=y
CONFIG_FAT_DEFAULT_IOCHARSET="utf8"
CONFIG_TMPFS=y
CONFIG_NLS_CODEPAGE_437=y
CONFIG_NLS_UTF8=y
CONFIG_DEBUG_FS=y
CONFIG_PSTORE=y
CONFIG_PSTORE_CONSOLE=y
CONFIG_PSTORE_PMSG=y
CONFIG_PSTORE_RAM=y
CONFIG_SECURITY=y
CONFIG_SECURITY_NETWORK=y
CONFIG_SECURITY_SELINUX=y
CONFIG_CRYPTO_DEV_QCOM_MSM_QCE=y
CONFIG_CRYPTO_DEV_QCRYPTO=y
CONFIG_CRYPTO_DEV_QCOM_ICE=y
CONFIG_MSM_MDSS_PLL=y
CONFIG_QCOM_LAZY_MAPPING=y
```

## kernel/overlay/drivers/battery/Kconfig
```kconfig
# C5's selected GPL battery drivers. Unported alternatives are not exposed.
menuconfig BATTERY_SAMSUNG
	bool "Samsung C5 battery bring-up candidate"
	depends on ARCH_MSM8952 && I2C && POWER_SUPPLY && OF
	select C5_CHARGING_MODE
	select SEC_CLASS
	select QPNP_VADC
	select MFD_SM5705
	help
	  Compile the C5 Samsung battery policy and its measured-board providers.
	  Compilation is not hardware acceptance of charging or thermal safety.

if BATTERY_SAMSUNG

config C5_RECOVERY_ONLY
	bool "C5 recovery-only profile: reject persistent AFC PARAM writes"
	default y

config BATTERY_SAMSUNG_V2
	bool "Samsung battery policy V2"
	default y

config BATTERY_SAMSUNG_DATA_FILE
	string "Samsung battery data file"
	default "default_battery_data.h"

config SLOW_CHARGING_CURRENT_STANDARD
	int "Slow charging current standard"
	default 1000

config BATTERY_SWELLING
	bool "Battery swelling protection"

config BATTERY_AGE_FORECAST
	bool "Battery age forecast"

config MULTI_CHARGING
	bool "Samsung multi-charger policy"

config STEP_CHARGING
	bool "Samsung step-charging policy"

config FUELGAUGE_SM5705
	bool "SM5705 fuel gauge"

config PREVENT_SOC_JUMP
	bool "Preserve SM5705 sudden state-of-charge change protection"

config CHARGER_SM5705
	bool "SM5705 charger"
	depends on MFD_SM5705

config CHARGER_DA9155
	bool "DA9155 secondary charger"

config AFC_CHARGER_MODE
	bool "Adaptive fast-charger mode"

config SAMSUNG_LPM_MODE
	bool "Samsung low-power charging mode"

config CHANGE_VBUS_VOLTAGE
	bool "MUIC adaptive VBUS voltage control"
	depends on MUIC_UNIVERSAL_SM5705_AFC

config SEC_MPP_SHARE
	bool "Samsung shared ADC multiplexer"

config SEC_MPP_SHARE_LOW_TEMP_WA
	bool "Shared headset/battery thermal ADC workaround"
	depends on SEC_MPP_SHARE && SAMSUNG_JACK

config SAMSUNG_JACK
	bool "Samsung headset-jack provider"
	depends on INPUT && GPIOLIB
	select SWITCH
	select INPUT_GPIO

config VBUS_NOTIFIER
	bool "Samsung VBUS notifier"

config USE_MUIC
	bool "Samsung MUIC hardware support"
	select MUIC_NOTIFIER

source "drivers/muic/universal/Kconfig"

endif

config THERMAL_TSENS8974
	bool "C5 MSM8952 TSENS calibration and temperature driver"
	depends on ARCH_MSM8952 && THERMAL
	depends on !THERMAL_TSENS && !QCOM_TSENS

config THERMAL_MONITOR
	bool "C5 kernel thermal CPU-frequency monitor"
	depends on THERMAL_TSENS8974
	depends on CPU_FREQ_MSM || (C5_RECOVERY_ONLY && CPU_FREQ)
	help
	  Keep native thermal monitoring in the recovery-only C5 CPUFreq-driver
	  isolation experiment. The CPUFreq core interfaces remain required.
	  Without a board CPUFreq driver, frequency-based mitigation is not
	  available; this does not certify thermal safety or a production kernel.

config MFD_SM5705
	bool "Siliconmitus SM5705 companion PMIC"
	depends on ARCH_MSM8952 && I2C=y
	select MFD_CORE

config REGULATOR_SM5705
	bool "SM5705 USB LDO regulators"
	depends on MFD_SM5705 && REGULATOR

source "drivers/switch/Kconfig"

config C5_USB_OTG_POWER
    bool "C5 checked SM5705 OTG operation backend"
    depends on C5_RECOVERY_ONLY && CHARGER_SM5705
    default n
    help
      Serialize operation-table transactions and propagate bus errors for the
      optional native C5 OTG source path. No new voltage/current tables.
```

## kernel/overlay/drivers/cpuidle/Kconfig
```kconfig
menu "CPU Idle"

config CPU_IDLE
	bool "CPU idle PM support"
	default y if ACPI || PPC_PSERIES
	select CPU_IDLE_GOV_LADDER if (!NO_HZ && !NO_HZ_IDLE)
	select CPU_IDLE_GOV_MENU if (NO_HZ || NO_HZ_IDLE)
	help
	  CPU idle is a generic framework for supporting software-controlled
	  idle processor power management.  It includes modular cross-platform
	  governors that can be swapped during runtime.

	  If you're using an ACPI-enabled platform, you should say Y here.

if CPU_IDLE

config CPU_IDLE_MULTIPLE_DRIVERS
        bool

config CPU_IDLE_GOV_LADDER
	bool "Ladder governor (for periodic timer tick)"

config CPU_IDLE_GOV_MENU
	bool "Menu governor (for tickless system)"

config DT_IDLE_STATES
	bool

menu "ARM CPU Idle Drivers"
depends on ARM || ARM64
source "drivers/cpuidle/Kconfig.arm"
endmenu

menu "MIPS CPU Idle Drivers"
depends on MIPS
source "drivers/cpuidle/Kconfig.mips"
endmenu

menu "POWERPC CPU Idle Drivers"
depends on PPC
source "drivers/cpuidle/Kconfig.powerpc"
endmenu

endif

config ARCH_NEEDS_CPU_IDLE_COUPLED
	def_bool n
endmenu

config C5_PM_SUSPEND_DIAGNOSTICS
 bool "C5 automatic suspend diagnostic callers"
 depends on ARM64 && !CPU_BIG_ENDIAN && ARCH_MSM8952 && !MODULES
 depends on CPU_IDLE && MSM_PM && PM_SLEEP && SYSFS
 depends on C5_PM_REGULATOR_DUMP && C5_PM_GPIO_DEBUG
 depends on C5_PM_QPNP_CACHE_DUMP && C5_PM_RPM_MASTER_PRINT
 default n
 help
   Restore automatic MEM suspend diagnostic callers for existing native
   providers. The GPIO/QPNP switch defaults to zero; RPM retains its
   per-printer exact-one enable gate. FREEZE callbacks remain unchanged.
```

## kernel/overlay/drivers/input/touchscreen/zinitix_zt7538/Kconfig
```kconfig
#
# Zinitix zt75xx Touchscreen driver configuration
#

config TOUCHSCREEN_ZT7538
	tristate "ZINITIX zt7538 I2C touchscreen driver"
	depends on I2C && OF && GPIOLIB && REGULATOR && PM_SLEEP
	depends on ARCH_MSM8952
	select SEC_CLASS
	select MUIC_NOTIFIER
	select C5_LCD_ID
	help
	  Say Y here if you have Zinitix zt7538 I2C touchscreen,
	  such as zt75xx, connected to your system.

	  If unsure, say N.

	  To compile this driver as a module, choose M here: the
	  module will be called zt7538.

config SECURE_TOUCH
	bool "ZT7538 secure-touch sysfs interface"
	depends on TOUCHSCREEN_ZT7538
	help
	  Compile the accepted C5 secure-touch interface. Runtime firmware
	  ownership and clocks require independent hardware acceptance.

config MUIC_NOTIFIER
	bool
	select SEC_CLASS

config SEC_CLASS
	bool
	select SOC_SAMSUNG

config C5_LCD_ID
	bool
```
